// Device Tree Overlay for RK3576 Mali-G52 MC3 Panfrost GPU
// Enables open-source Panfrost GPU driver (Mesa)
// RK3576: Mali-G52 MC3 GPU, 6 TOPS NPU
//
// Usage: Add to extlinux.conf:
//   fdtoverlays /usr/lib/linux-image-*/rockchip/overlay/rockchip-rk3576-panfrost-gpu.dtbo
//
// Armbian linux-rockchip already supports panfrost for RK3576 GPU
// This overlay ensures proper power domain setup

/dts-v1/;
/plugin/;

/ {
    fragment@0 {
        target = <&gpu>;
        __overlay__ {
            status = "okay";
        };
    };

    fragment@1 {
        target = <&gpu_bus>;
        __overlay__ {
            status = "okay";
        };
    };

    fragment@2 {
        target = <&pd_gpu>;
        __overlay__ {
            status = "okay";
        };
    };
};
