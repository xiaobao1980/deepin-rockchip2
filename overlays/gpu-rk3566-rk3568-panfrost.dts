// Device Tree Overlay for RK3566/RK3568 Mali-G52 Panfrost GPU
// Enables open-source Panfrost GPU driver (Mesa)
//
// Usage: Add to extlinux.conf:
//   fdtoverlays /usr/lib/linux-image-*/rockchip/overlay/rockchip-rk356x-panfrost-gpu.dtbo
//
// Or load manually:
//   dtoverlay rockchip-rk356x-panfrost-gpu

/dts-v1/;
/plugin/;

#include <dt-bindings/gpio/gpio.h>
#include <dt-bindings/pinctrl/rockchip.h>

/ {
    fragment@0 {
        target-path = "/";
        __overlay__ {
            // Ensure GPU power domain is enabled
            // Panfrost requires mali-supply and sram-supply
        };
    };

    fragment@1 {
        target = <&gpu>;
        __overlay__ {
            // Ensure GPU is enabled for panfrost
            status = "okay";
            // mali-supply should be defined in base DTB
            // If missing, panfrost will attempt to find it
        };
    };

    fragment@2 {
        target = <&gpu_bus>;
        __overlay__ {
            status = "okay";
        };
    };

    fragment@3 {
        target = <&pd_gpu>;
        __overlay__ {
            status = "okay";
        };
    };
};
